// Copyright 2021 Manna Harbour
// https://github.com/manna-harbour/miryoku
// GAME Layer Activation - Hold all three left thumb keys for 2 seconds

/ {
  combos {
    compatible = "zmk,combos";
    
    game_toggle_combo {
      timeout-ms = <2000>;
      key-positions = <36 37 38>;
      bindings = <&to U_GAME>;
      layers = <U_BASE>;
    };   
    
    game_return_combo {
      timeout-ms = <2000>;
      key-positions = <36 37 38>;
      bindings = <&to U_BASE>;
      layers = <U_GAME>;
    };
  };
};
